## main/Kconfig
```kconfig
menu "BT-UART Bridge Configuration"

config CONNECTED_LED_GPIO
    int "Connected indicator GPIO number"
	range 0 34
	default 6
	help
		GPIO number (IOxx) for connected status indication.

config UART_TX_GPIO
    int "UART TX GPIO number"
	range 0 34
	default 4
	help
		GPIO number (IOxx) for serial data TX output.

config UART_RX_GPIO
    int "UART RX GPIO number"
	range 0 34
	default 5
	help
		GPIO number (IOxx) for serial data RX input.

config UART_BITRATE
    int "UART baud rate"
	range 9600 1843200
	default 38400
	help
		UART data transfer rate in bits per second.

config UART_TX_BUFF_SIZE
    int "UART transmit buffer size (KB)"
	range 0 64
	default 17
	help
		UART transmit data buffer size in kilobytes.

config UART_RX_BUFF_SIZE
    int "UART receive buffer size (KB)"
	range 1 64
	default 17
	help
		UART receive data buffer size in kilobytes.

config DEV_NAME_PREFIX
    string "Bluetooth device name prefix"
	default "EasyToTrack-"
	help
		The fixed part of the bluetooth device name. It will be followed by serial number based on the MAC address.

endmenu

menu "OLED Configuration"

config DEFAULT_OLED_TYPE
	int "Display type"
	default "1306"
	help 
		OLED display type. Possible values are: 0:none, 1306:ssd1306, 1106:sh1106, 1309:ssd1309, 1318:ssd1318, 1325:ssd1325

config DEFAULT_OLED_FLIP 
	int "Display flip"
	default "0"
	range 0 1
	help 
		OLED display flip. 0 : no rotation, 1 : rotate display up side down

endmenu

menu "EasyToTrack Type"

	config ETT_ESP32_ONLY
		int "Single ESP32 Module - Without ATmega8 telemetry-over-video module"
		default "0"
		range 0 1
		help 
			Set to 1 if you have a dedicated hardware for telemetry-over-video configuration (with ATmega8). Set to 0 if you want to use a bare ESP32 board for EasyToTrack project

	endmenu
```
